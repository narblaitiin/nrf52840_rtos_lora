## CMakeLists.txt
```
cmake_minimum_required(VERSION 3.20.0)

find_package(Zephyr REQUIRED HINTS $ENV{ZEPHYR_BASE})
project(nrf52840_rtos_lora)

FILE(GLOB app_sources src/*.c)
target_sources(app PRIVATE ${app_sources})
```

## prj.conf
```kconfig
# Debugger Support
CONFIG_UART_CONSOLE=y
CONFIG_CONSOLE=y

# Communication Bus Support
CONFIG_GPIO=y
CONFIG_SPI=y

# LoRa Support
CONFIG_LORA=y

# Random Number Generation Support
CONFIG_TEST_RANDOM_GENERATOR=y
```

## src/main.c
```c
/*
 * Copyright (c) 2025
 * Regis Rousseau
 * Univ Lyon, INSA Lyon, Inria, CITI, EA3720
 * SPDX-License-Identifier: Apache-2.0
 */

//  ========== includes ====================================================================
#include "app_lora.h"

//  =========== globals ====================================================================
static const struct gpio_dt_spec led_tx = GPIO_DT_SPEC_GET(LED_TX, gpios);

//  ========== main ========================================================================
int8_t main(void)
{
	const struct device *lora_dev;
	int8_t ret;
	int8_t itr = 0;
	int16_t payload;

	printk("LoRa Transmitter Example\nBoard: %s\n", CONFIG_BOARD);
	
	// setup lora radio device
	lora_dev = DEVICE_DT_GET(DT_ALIAS(lora0));
	if (!device_is_ready(lora_dev)) {
		printk("%s: device not ready\n", lora_dev->name);
		return 0;
	}

	// setup tx led at GPIO PC0
	ret = gpio_pin_configure_dt(&led_tx, GPIO_OUTPUT_ACTIVE);
	if (ret < 0) {
		return 0;
	}

	// configuration of lora parameters 
	if (app_lora_config(lora_dev, TRANSMIT)) {
		printk("LoRa device configured\n");
	} else {
			return 0;
		}

	// transmission of packets on lora phy layer forever
	while (1) {
		// data to be transmitted
		payload = sys_rand16_get();	// random value simulating ADC value in int16 format

		ret = lora_send(lora_dev, &payload, sizeof(payload));
		if (ret < 0) {
			printk("LoRa send failed. error%d\n", ret);
			return 0;
		} else {
			// flashing of the LED when a packet is transmitted
			ret = gpio_pin_toggle_dt(&led_tx);	 
			if (ret < 0) {
				return 0;
			}
			
			// printing of data and size of packets
			printk("XMIT %d bytes: \n", sizeof(payload));
			printk("value: %d\n", payload);
			printk("\n");
		}
		k_sleep(K_MSEC(1000));	// like zephyr lora driver sample
	}
	return 0;
}
```

## src/app_lora.c
```c
/*
 * Copyright (c) 2025
 * Regis Rousseau
 * Univ Lyon, INSA Lyon, Inria, CITI, EA3720
 * SPDX-License-Identifier: Apache-2.0
 */

//  ========== includes ====================================================================
#include "app_lora.h"

//  ========== app_lora_config =============================================================
int8_t app_lora_config(const struct device *dev, bool TxRx)
{
	int8_t ret;
	struct lora_modem_config config;

	// constants of lora phy layer
	config.frequency = 868100000;
	config.bandwidth = BW_125_KHZ;
	config.datarate = SF_9;
	config.preamble_len = 8;
	config.coding_rate = CR_4_5;
	config.tx_power = 17;
	config.iq_inverted = false;
	config.public_network = false;
	config.tx = TxRx;

	// setup of lora phy layer
	ret = lora_config(dev, &config);
	if (ret < 0) {
		printk("lora device configuration failed. error: %d\n", ret);
		return 0;
	}
	return 0;
}
```

## src/app_lora.h
```c
/*
 * Copyright (c) 2025
 * Regis Rousseau
 * Univ Lyon, INSA Lyon, Inria, CITI, EA3720
 * SPDX-License-Identifier: Apache-2.0
 */

#ifndef APP_LORA_H
#define APP_LORA_H

//  ========== includes ====================================================================
#include <zephyr/device.h>
#include <zephyr/kernel.h>
#include <zephyr/drivers/lora.h>
#include <zephyr/drivers/gpio.h>
#include <zephyr/random/random.h>

//  ========== defines =====================================================================
#define TRANSMIT    1
#define RECEIVE     0
#define LED_TX      DT_ALIAS(ledtx)  // declared in device tree 

//  ========== prototypes ==================================================================
int8_t app_lora_config(const struct device *dev, bool TxRx);

#endif /* APP_LORA_H */
```
